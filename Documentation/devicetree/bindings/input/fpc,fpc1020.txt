## Documentation/devicetree/bindings/input/fpc,fpc1020.txt
```
fpc,fpc1020


Required properties:

- compatible : should be compatible = "fpc,fpc1020";

example:
	fpc_fpc1020 {
		compatible = "fpc,fpc1020";
		interrupt-parent = <&tlmm>;
		fpc,irq-gpio     = <&tlmm 121 0>;
		fpc,reset-gpio   = <&tlmm 35 0>;
		pinctrl-names = "fp_reset_high", "fp_reset_low";
		pinctrl-0 = <&fp_reset_high>;
		pinctrl-1 = <&fp_reset_low>;
	};
```

## Documentation/devicetree/bindings/input/goodix,fingerprint.txt
```
goodix,fingerprint


Required properties:

- compatible : should be compatible = "goodix,fingerprint";

example:

	goodix_fp {
	    compatible = "goodix,fingerprint";
		interrupt-parent = <&tlmm>;
		fp-gpio-irq = <&tlmm 121 0x00>;
		fp-gpio-reset = <&tlmm 35 0x00>;
		status = "okay";
	};
```

## arch/arm64/configs/vendor/beryllium_defconfig
```kconfig
CONFIG_HARDEN_BRANCH_PREDICTOR=y
CONFIG_PSCI_BP_HARDENING=y
CONFIG_TOUCHSCREEN_FTS=y
CONFIG_FINGERPRINT_FPC_TEE=y
CONFIG_USE_BU64748=y
CONFIG_SND_SOC_TAS2559=y
CONFIG_MACH_XIAOMI_E10=y
```

## drivers/input/touchscreen/focaltech_touch/Kconfig
```kconfig
#
# Focaltech Touchscreen driver configuration
#

config TOUCHSCREEN_FTS
	bool "Focaltech Touchscreen"
	depends on I2C
	default n
	help
	  Say Y here if you have Focaltech touch panel.
	  If unsure, say N.

config TOUCHSCREEN_FTS_POWER_SUPPLY
	bool "USB Power Supply"
	default n
	help
	  Say y here if phone type is perseus
	  If unsure, say N

config TOUCHSCREEN_FTS_DIRECTORY
	string "Focaltech ts directory name"
	default "focaltech_touch"
	depends on TOUCHSCREEN_FTS
	help
	  Specify the path for the driver directory.
	  Path should be relative to driver/input/touchscreen/.
```

## drivers/input/touchscreen/fts_521/Kconfig
```kconfig
config TOUCHSCREEN_ST_FTS_V521
	tristate "ST FTS V521 I2C Touchscreen"
	depends on I2C
	help
	  Say Y here if you have ST FTS series I2C touchscreen.

	  If unsure, say N.

	  To compile this driver as a module, choose M here: the

config TOUCHSCREEN_ST_DEBUG_FS
	tristate "St core driver module"
	depends on TOUCHSCREEN_ST_FTS_V521
	help
          Say Y here to enable  touch debugfs functionality.

          If unsure, say N.

config I2C_BY_DMA
	bool "I2C by DMA"
	depends on TOUCHSCREEN_ST_FTS_V521

config SECURE_TOUCH
	bool "Secure Touch support for ST FTS V521 Touchscreen"
	depends on TOUCHSCREEN_ST_FTS_V521
```

## drivers/input/touchscreen/nt36xxx/Kconfig
```kconfig
#
# Novatek NT36xxx touchscreen driver configuration
#
config TOUCHSCREEN_NT36XXX
	bool "Novatek NT36XXX"
	default n
	help
	  Say Y here if you have a Novatek NT36xxx touchscreen connected
	  to your system.

	  If unsure, say N.

config TOUCHSCREEN_NT36XXX_MP_CTRLRAM
	bool "Novatek NT36XXX Multipoint Control RAM"
	depends on TOUCHSCREEN_NT36XXX
	default n
	help
	  Say Y here if you need to use Multipoint Control RAM Testing

	  If unsure, say N.

config TOUCHSCREEN_NT36XXX_ESD_PROTECT
	bool "Novatek NT36XXX ESD Touch Protect"
	depends on TOUCHSCREEN_NT36XXX
	default n
	help
	  Say Y here if you need to use ESD Touch Protect.

	  If unsure, say N.
```

## techpack/audio/Kconfig
```kconfig
menu "Techpack audio options"

config AUDIO_EXT_CLK
	tristate "AUDIO_EXT_CLK"

config DOLBY_DS2
	tristate "DOLBY_DS2"

config DOLBY_LICENSE
	tristate "DOLBY_LICENSE"

config DTS_EAGLE
	tristate "DTS_EAGLE"

config DTS_SRS_TM
	tristate "DTS_SRS_TM"

config MSM_ADSP_LOADER
	tristate "MSM_ADSP_LOADER"

config MSM_AVTIMER
	tristate "MSM_AVTIMER"

config MSM_CDC_PINCTRL
	tristate "MSM_CDC_PINCTRL"

config MSM_GLINK_SPI_XPRT
	tristate "MSM_GLINK_SPI_XPRT"

config MSM_QDSP6_APRV2_GLINK
	tristate "MSM_QDSP6_APRV2_GLINK"

config MSM_QDSP6_NOTIFIER
	tristate "MSM_QDSP6_NOTIFIER"

config MSM_QDSP6_PDR
	tristate "MSM_QDSP6_PDR"

config MSM_QDSP6_SSR
	tristate "MSM_QDSP6_SSR"

config MSM_QDSP6V2_CODECS
	tristate "MSM_QDSP6V2_CODECS"

config MSM_ULTRASOUND
	tristate "MSM_ULTRASOUND"

config PINCTRL_LPI
	tristate "PINCTRL_LPI"

config PINCTRL_WCD
	tristate "PINCTRL_WCD"

config QTI_PP
	tristate "QTI_PP"

config REGMAP_SWR
	tristate "REGMAP_SWR"

config SND_HWDEP_ROUTING
	tristate "SND_HWDEP_ROUTING"

config SND_SOC_ANALOG_CDC
	tristate "SND_SOC_ANALOG_CDC"

config SND_SOC_DIGITAL_CDC
	tristate "SND_SOC_DIGITAL_CDC"

config SND_SOC_EXT_CODEC
	tristate "SND_SOC_EXT_CODEC"

config SND_SOC_INT_CODEC
	tristate "SND_SOC_INT_CODEC"

config SND_SOC_MACHINE_SDM845
	tristate "SND_SOC_MACHINE_SDM845"

config SND_SOC_MSM_HDMI_CODEC_RX
	tristate "SND_SOC_MSM_HDMI_CODEC_RX"

config SND_SOC_MSM_HOSTLESS_PCM
	tristate "SND_SOC_MSM_HOSTLESS_PCM"

config SND_SOC_MSM_QDSP6V2_INTF
	tristate "SND_SOC_MSM_QDSP6V2_INTF"

config SND_SOC_MSM_SDW
	tristate "SND_SOC_MSM_SDW"

config SND_SOC_MSM_STUB
	tristate "SND_SOC_MSM_STUB"

config SND_SOC_QDSP6V2
	tristate "SND_SOC_QDSP6V2"

config SND_SOC_SDM660_CDC
	tristate "SND_SOC_SDM660_CDC"

config SND_SOC_SDM670
	tristate "SND_SOC_SDM670"

config SND_SOC_SDM845
	tristate "SND_SOC_SDM845"

config SND_SOC_TAS2557
	tristate "SND_SOC_TAS2557"

config SND_SOC_TAS2559
	tristate "SND_SOC_TAS2559"

config SND_SOC_WCD9335
	tristate "SND_SOC_WCD9335"

config SND_SOC_WCD934X
	tristate "SND_SOC_WCD934X"

config SND_SOC_WCD934X_DSD
	tristate "SND_SOC_WCD934X_DSD"

config SND_SOC_WCD934X_MBHC
	tristate "SND_SOC_WCD934X_MBHC"

config SND_SOC_WCD9XXX_V2
	tristate "SND_SOC_WCD9XXX_V2"

config SND_SOC_WCD_CPE
	tristate "SND_SOC_WCD_CPE"

config SND_SOC_WCD_DSP_MGR
	tristate "SND_SOC_WCD_DSP_MGR"

config SND_SOC_WCD_MBHC
	tristate "SND_SOC_WCD_MBHC"

config SND_SOC_WCD_MBHC_ADC
	tristate "SND_SOC_WCD_MBHC_ADC"

config SND_SOC_WCD_MBHC_LEGACY
	tristate "SND_SOC_WCD_MBHC_LEGACY"

config SND_SOC_WCD_SPI
	tristate "SND_SOC_WCD_SPI"

config SND_SOC_WSA881X
	tristate "SND_SOC_WSA881X"

config SOUNDWIRE
	tristate "SOUNDWIRE"

config SOUNDWIRE_WCD_CTRL
	tristate "SOUNDWIRE_WCD_CTRL"

config TAS2557_CODEC
	tristate "TAS2557_CODEC"

config TAS2557_MISC
	tristate "TAS2557_MISC"

config TAS2557_REGMAP
	tristate "TAS2557_REGMAP"

config WCD9XXX_CODEC_CORE
	tristate "WCD9XXX_CODEC_CORE"

config WCD_DSP_GLINK
	tristate "WCD_DSP_GLINK"

config WCD_SPI_AC
	tristate "WCD_SPI_AC"

endmenu
```

## techpack/audio/asoc/codecs/tas2557/Kconfig
```kconfig
config TAS2557_CODEC
	tristate "TAS2557_CODEC"
config TAS2557_MISC
	tristate "TAS2557_MISC"
config TAS2557_REGMAP
	tristate "TAS2557_REGMAP"
```
