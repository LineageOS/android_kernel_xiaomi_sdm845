/* Copyright (c) 2015, The Linux Foundation. All rights reserved.
 * Copyright (C) 2018 XiaoMi, Inc.
 *
 * This program is free software; you can redistribute it and/or modify
 * it under the terms of the GNU General Public License version 2 and
 * only version 2 as published by the Free Software Foundation.
 *
 * This program is distributed in the hope that it will be useful,
 * but WITHOUT ANY WARRANTY; without even the implied warranty of
 * MERCHANTABILITY or FITNESS FOR A PARTICULAR PURPOSE.  See the
 * GNU General Public License for more details.
 */

/*---------------------------------------------------------------------------
 * This file is autogenerated file using gcdb parser. Please do not edit it.
 * Update input XML file to add a new entry or update variable in this file
 * VERSION = "1.0"
 *---------------------------------------------------------------------------*/
&soc {
	dsi_tianma_fhd_nt36672a_video: qcom,mdss_dsi_tianma_fhd_nt36672a_video {
			qcom,mdss-dsi-panel-name = "tianma fhd video dsi panel";
			qcom,mdss-dsi-panel-id = < 0x00 >;
			qcom,mdss-dsi-panel-model = "TIANMA FHD NT36672A VIDEO PANEL";
			qcom,mdss-dsi-panel-type = "dsi_video_mode";
			qcom,mdss-dsi-virtual-channel-id = < 0x00 >;
			qcom,mdss-dsi-stream = < 0x00 >;
			qcom,mdss-dsi-bpp = < 0x18 >;
			qcom,mdss-dsi-color-order = "rgb_swap_rgb";
			qcom,mdss-dsi-underflow-color = < 0x00 >;
			qcom,mdss-dsi-border-color = < 0x00 >;
			qcom,mdss-dsi-traffic-mode = "burst_mode";
			qcom,mdss-dsi-bllp-eof-power-mode;
			qcom,mdss-dsi-bllp-power-mode;
			qcom,mdss-dsi-lp11-init;
			qcom,mdss-dsi-lane-0-state;
			qcom,mdss-dsi-lane-1-state;
			qcom,mdss-dsi-lane-2-state;
			qcom,mdss-dsi-lane-3-state;
			qcom,mdss-dsi-bl-min-level = < 0x01 >;
			qcom,mdss-dsi-bl-max-level = < 0xfff >;
			qcom,mdss-brightness-max-level = < 0xfff >;
			qcom,mdss-dsi-dma-trigger = "trigger_sw";
			qcom,mdss-dsi-mdp-trigger = "none";
			qcom,mdss-dsi-reset-sequence = < 0x00 0x0a 0x01 0x0a >;
			qcom,mdss-pan-physical-width-dimension = < 0x44 >;
			qcom,mdss-pan-physical-height-dimension = < 0x88 >;
			qcom,cont-splash-enabled;
			qcom,mdss-dsi-tx-eot-append;
			qcom,mdss-dsi-panel-hdr-enabled;
			qcom,mdss-dsi-panel-hdr-color-primaries = < 0x38a4 0x3c8c 0x7d00 0x4268 0x3c8c 0x7530 0x1f40 0xbb8 >;
			qcom,mdss-dsi-panel-peak-brightness = < 0x401640 >;
			qcom,mdss-dsi-panel-blackness-level = < 0xc9e >;
			qcom,esd-err-irq-gpio = < 0x3c 0x0a 0x2001 >;
			qcom,dispparam-enabled;
			qcom,mdss-panel-on-dimming-delay = < 0x78 >;
			qcom,ulps-enabled;
	 		qcom,suspend-ulps-enabled;
			qcom,panel-allow-phy-poweroff;
			qcom,mdss-dsi-t-clk-post = < 0x0e >;
			qcom,mdss-dsi-t-clk-pre = < 0x33 >;
			qcom,panel-supply-entries = < 0x35f >;
			qcom,mdss-dsi-bl-pmic-control-type = "bl_ctrl_wled";
			qcom,platform-reset-gpio = < 0x3c 0x06 0x00 >;

			qcom,mdss-dsi-display-timings {

				timing@0 {
					qcom,mdss-dsi-panel-framerate = < 0x45 >;
					qcom,mdss-dsi-panel-width = < 0x438 >;
					qcom,mdss-dsi-panel-height = < 0x8c6 >;
					qcom,mdss-dsi-h-front-porch = < 0x28 >;
					qcom,mdss-dsi-h-back-porch = < 0x2c >;
					qcom,mdss-dsi-h-pulse-width = < 0x14 >;
					qcom,mdss-dsi-h-sync-skew = < 0x00 >;
					qcom,mdss-dsi-v-back-porch = < 0x08 >;
					qcom,mdss-dsi-v-front-porch = < 0x0f >;
					qcom,mdss-dsi-v-pulse-width = < 0x02 >;
					qcom,mdss-dsi-h-left-border = < 0x00 >;
					qcom,mdss-dsi-h-right-border = < 0x00 >;
					qcom,mdss-dsi-v-top-border = < 0x00 >;
					qcom,mdss-dsi-v-bottom-border = < 0x00 >;
					qcom,mdss-dsi-panel-jitter = <0x8>;
					qcom,mdss-dsi-on-command = < 0x15010000 0x2ff 0x22150000 0x02 0x401500 0x00 0x201c015 0x00 0x20240 0x15000000 0x203 0x40150000 0x02 0x4401500 0x00 0x2054015 0x00 0x20640 0x15000000 0x207 0x40150000 0x02 0x8401500 0x00 0x2094015 0x00 0x20a40 0x15000000 0x20b 0x40150000 0x02 0xc401500 0x00 0x20d4015 0x00 0x20e40 0x15000000 0x20f 0x40150000 0x02 0x10401500 0x00 0x2115015 0x00 0x21260 0x15000000 0x213 0x70150000 0x02 0x14581500 0x00 0x2156815 0x00 0x21678 0x15010000 0x217 0x77150000 0x02 0x18391500 0x00 0x2192d15 0x00 0x21a2e 0x15000000 0x21b 0x32150000 0x02 0x1c371500 0x00 0x21d3a15 0x00 0x21e40 0x15000000 0x21f 0x40150000 0x02 0x20401500 0x00 0x2214015 0x00 0x22240 0x15000000 0x223 0x40150000 0x02 0x24401500 0x00 0x2254015 0x00 0x22640 0x15000000 0x227 0x40150000 0x02 0x28401500 0x00 0x22d0015 0x00 0x22f40 0x15000000 0x230 0x40150000 0x02 0x31401500 0x00 0x2324015 0x00 0x23340 0x15000000 0x234 0x40150100 0x02 0x35401500 0x00 0x2364015 0x00 0x23740 0x15000000 0x238 0x40150000 0x02 0x39401500 0x00 0x23a4015 0x00 0x23b40 0x15000000 0x23d 0x40150000 0x02 0x3f401500 0x00 0x2404015 0x00 0x24140 0x15000000 0x242 0x40150000 0x02 0x43401500 0x00 0x2444015 0x00 0x24540 0x15000000 0x246 0x40150000 0x02 0x47401500 0x00 0x2484015 0x00 0x24940 0x15000000 0x24a 0x40150000 0x02 0x4b401500 0x00 0x24c4015 0x00 0x24d40 0x15000000 0x24e 0x40150000 0x02 0x4f401501 0x00 0x2504015 0x00 0x25140 0x15000000 0x252 0x40150000 0x02 0x53011500 0x00 0x2540115 0x00 0x255fe 0x15000000 0x256 0x77150000 0x02 0x58cd1500 0x00 0x259d015 0x00 0x25ad0 0x15000000 0x25b 0x50150000 0x02 0x5c501500 0x00 0x25d5015 0x00 0x25e50 0x15000000 0x25f 0x50150000 0x02 0x60501500 0x00 0x2615015 0x00 0x26250 0x15000000 0x263 0x50150000 0x02 0x64501500 0x00 0x2655015 0x00 0x26650 0x15000000 0x267 0x50150000 0x02 0x68501500 0x00 0x2695015 0x1000000 0x26a50 0x15000000 0x26b 0x50150000 0x02 0x6c501500 0x00 0x26d5015 0x00 0x26e50 0x15000000 0x26f 0x50150000 0x02 0x70071500 0x00 0x2710015 0x00 0x27200 0x15000000 0x273 0x150000 0x02 0x74061500 0x00 0x2750c15 0x00 0x27603 0x15000000 0x277 0x9150000 0x02 0x780f1500 0x00 0x2796815 0x00 0x27a88 0x15000000 0x27c 0x80150000 0x02 0x7d801500 0x00 0x27e8015 0x00 0x27f00 0x15000000 0x280 0x150000 0x02 0x81001500 0x00 0x2830115 0x00 0x28400 0x15010000 0x285 0x80150000 0x02 0x86801500 0x00 0x2878015 0x00 0x28840 0x15000000 0x289 0x91150000 0x02 0x8a981500 0x00 0x28b8015 0x00 0x28c80 0x15000000 0x28d 0x80150000 0x02 0x8e801500 0x00 0x28f8015 0x00 0x29080 0x15000000 0x291 0x80150000 0x02 0x92801500 0x00 0x2938015 0x00 0x29480 0x15000000 0x295 0x80150000 0x02 0x96801500 0x00 0x2978015 0x00 0x29880 0x15000000 0x299 0x80150000 0x02 0x9a801500 0x00 0x29b8015 0x00 0x29c80 0x15000000 0x29d 0x80150100 0x02 0x9e801500 0x00 0x29f8015 0x00 0x2a08a 0x15000000 0x2a2 0x80150000 0x02 0xa6801500 0x00 0x2a78015 0x00 0x2a980 0x15000000 0x2aa 0x80150000 0x02 0xab801500 0x00 0x2ac8015 0x00 0x2ad80 0x15000000 0x2ae 0x80150000 0x02 0xaf801500 0x00 0x2b77615 0x00 0x2b876 0x15000000 0x2b9 0x5150000 0x02 0xba0d1500 0x00 0x2bb1415 0x00 0x2bc0f 0x15000000 0x2bd 0x18150000 0x02 0xbe1f1500 0x00 0x2bf0515 0x00 0x2c00d 0x15000000 0x2c1 0x14150000 0x02 0xc2031501 0x00 0x2c30715 0x00 0x2c40a 0x15000000 0x2c5 0xa0150000 0x02 0xc6551500 0x00 0x2c7ff15 0x00 0x2c839 0x15000000 0x2c9 0x44150000 0x02 0xca121500 0x00 0x2cd8015 0x00 0x2db80 0x15000000 0x2dc 0x80150000 0x02 0xdd801500 0x00 0x2e08015 0x00 0x2e180 0x15000000 0x2e2 0x80150000 0x02 0xe3801500 0x00 0x2e48015 0x00 0x2e540 0x15000000 0x2e6 0x40150000 0x02 0xe7401500 0x00 0x2e84015 0x00 0x2e940 0x15000000 0x2ea 0x40150000 0x02 0xeb401500 0x00 0x2ec4015 0x00 0x2ed40 0x15000000 0x2ee 0x40150000 0x02 0xef401500 0x00 0x2f04015 0x00 0x2f140 0x15000000 0x2f2 0x40150000 0x02 0xf3401500 0x00 0x2f44015 0x00 0x2f540 0x15000000 0x2f6 0x40150100 0x02 0xfb011501 0x00 0x2ff2315 0x00 0x2fb01 0x15000000 0x201 0x84150000 0x02 0x52d1500 0x00 0x2060015 0x00 0x21101 0x15000000 0x212 0x7b150000 0x02 0x156f1500 0x00 0x2160b15 0x00 0x2290a 0x15000000 0x230 0xff150000 0x02 0x31ff1500 0x00 0x232ff15 0x00 0x233ff 0x15000000 0x234 0xff150000 0x02 0x35ff1500 0x00 0x236ff15 0x00 0x237ff 0x15000000 0x238 0xfc150100 0x02 0x39f81500 0x00 0x23af415 0x00 0x23bf1 0x15000000 0x23d 0xee150000 0x02 0x3feb1500 0x00 0x240e815 0x00 0x241e5 0x15000000 0x22a 0x13150000 0x02 0x45ff1500 0x00 0x246ff15 0x00 0x247ff 0x15000000 0x248 0xff150000 0x02 0x49ff1500 0x00 0x24aff15 0x00 0x24bff 0x15000000 0x24c 0xff150000 0x02 0x4ded1500 0x00 0x24ed515 0x00 0x24fbf 0x15000000 0x250 0xa6150100 0x02 0x51961500 0x00 0x2528615 0x00 0x25376 0x15000000 0x254 0x66150000 0x02 0x2b0e1500 0x00 0x258ff15 0x00 0x259ff 0x15000000 0x25a 0xff150000 0x02 0x5bff1500 0x00 0x25cff15 0x00 0x25dff 0x15000000 0x25e 0xff150000 0x02 0x5fff1500 0x00 0x260f615 0x00 0x261ea 0x15000000 0x262 0xe1150000 0x02 0x63d81500 0x00 0x264ce15 0x00 0x265c3 0x15000000 0x266 0xba150100 0x02 0x67b31501 0x00 0x2ff2515 0x00 0x2fb01 0x15000000 0x205 0x4150100 0x02 0xff261500 0x00 0x2fb0115 0x00 0x21caf 0x15010000 0x2ff 0x10150000 0x02 0xfb011500 0x00 0x251ff15 0x00 0x25324 0x15000000 0x255 0x50100 0x02 0x29000501 0x4600 0x2110015 0x1000000 0x2ff24 0x15000000 0x2fb 0x1150000 0x02 0xc3011500 0x00 0x2c45415 0x1000000 0x2ff10 >;
					qcom,mdss-dsi-off-command = [ 15 01 00 00 00 00 02 ff 24 15 00 00 00 00 00 02 fb 01 15 00 00 00 00 00 02 c3 00 15 01 00 00 00 00 02 ff 10 05 01 00 00 00 00 02 28 00 05 01 00 00 3c 00 02 10 00 ];
					qcom,mdss-dsi-on-command-state = "dsi_lp_mode";
					qcom,mdss-dsi-off-command-state = "dsi_hs_mode";
					qcom,mdss-dsi-h-sync-pulse = < 0x01 >;
					qcom,mdss-dsi-dispparam-cabcuion-command = [ 15 01 00 00 00 00 02 55 01 ];
					qcom,mdss-dsi-dispparam-cabcuion-command-state = "dsi_hs_mode";
					qcom,mdss-dsi-dispparam-cabcstillon-command = [ 15 01 00 00 00 00 02 55 02 ];
					qcom,mdss-dsi-dispparam-cabcstillon-command-state = "dsi_hs_mode";
					qcom,mdss-dsi-dispparam-cabcmovieon-command = [ 15 01 00 00 00 00 02 55 03 ];
					qcom,mdss-dsi-dispparam-cabcmovieon-command-state = "dsi_hs_mode";
					qcom,mdss-dsi-dispparam-cabcoff-command = [ 39 01 00 00 01 00 02 55 00 ];
					qcom,mdss-dsi-dispparam-cabcoff-command-state = "dsi_hs_mode";
					qcom,mdss-dsi-dispparam-dimmingon-command = [ 39 01 00 00 01 00 02 53 2c ];
					qcom,mdss-dsi-dispparam-dimmingon-command-state = "dsi_hs_mode";
					qcom,mdss-dsi-dispparam-skince-cabcuion-command = [ 15 01 00 00 00 00 02 55 81 ];
					qcom,mdss-dsi-dispparam-skince-cabcuion-command-state = "dsi_hs_mode";
					qcom,mdss-dsi-dispparam-skince-cabcstillon-command = [ 15 01 00 00 00 00 02 55 82 ];
					qcom,mdss-dsi-dispparam-skince-cabcstillon-command-state = "dsi_hs_mode";
					qcom,mdss-dsi-dispparam-skince-cabcmovieon-command = [ 15 01 00 00 00 00 02 55 83 ];
					qcom,mdss-dsi-dispparam-skince-cabcmovieon-command-state = "dsi_hs_mode";
					qcom,mdss-dsi-dispparam-skince-cabcoff-command = [ 15 01 00 00 00 00 02 55 80 ];
					qcom,mdss-dsi-dispparam-skince-cabcoff-command-state = "dsi_hs_mode";
					qcom,mdss-dsi-panel-phy-timings = < 0x210808 0x25220908 0x6030400 >;
					qcom,display-topology = < 0x01 0x00 0x01 >;
					qcom,default-topology-index = < 0x00 >;
			};
		};
	};
};
