## drivers/block/zram/Kconfig
```kconfig
config ZRAM
	tristate "Compressed RAM block device support"
	depends on BLOCK && SYSFS && ZSMALLOC && CRYPTO
	select CRYPTO_LZO
	default n
	help
	  Creates virtual block devices called /dev/zramX (X = 0, 1, ...).
	  Pages written to these disks are compressed and stored in memory
	  itself. These disks allow very fast I/O and compression provides
	  good amounts of memory savings.

	  It has several use cases, for example: /tmp storage, use as swap
	  disks and maybe many more.

	  See Documentation/blockdev/zram.txt for more information.

config ZRAM_WRITEBACK
       bool "Write back incompressible or idle page to backing device"
       depends on ZRAM
       default n
       help
	 With incompressible page, there is no memory saving to keep it
	 in memory. Instead, write it out to backing device.
	 For this feature, admin should set up backing device via
	 /sys/block/zramX/backing_dev.

	 With /sys/block/zramX/{idle,writeback}, application could ask
	 idle page's writeback to the backing device to save in memory.

	 See Documentation/blockdev/zram.txt for more information.

config ZRAM_MEMORY_TRACKING
	bool "Track zRam block status"
	depends on ZRAM && DEBUG_FS
	help
	  With this feature, admin can track the state of allocated blocks
	  of zRAM. Admin could see the information via
	  /sys/kernel/debug/zram/zramX/block_state.

	  See Documentation/blockdev/zram.txt for more information.

config ZRAM_DEFAULT_COMP_ALGORITHM
	string "Default ZRAM compression algorithm"
	default "lz4"

config ZRAM_ENTROPY
	bool "Use entropy optimization for zram"
	depends on ZRAM
	help
	  With this feature, entropy will be calculated for each page.
	  Pages above ZRAM_ENTROPY_THRESHOLD entropy will be
	  stored uncompressed. Use this feature if you need a performance
	  boost and a small loss in compression.

config ZRAM_ENTROPY_THRESHOLD
	int
	depends on ZRAM && ZRAM_ENTROPY
	default 100000
	help
	  Pages with entropy above ZRAM_ENTROPY_THRESHOLD will be stored
	  uncompressed. The default value was chosen as a 
```
